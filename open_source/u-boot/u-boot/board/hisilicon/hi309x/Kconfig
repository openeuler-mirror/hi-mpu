## open_source/u-boot/u-boot/board/hisilicon/hi309x/Kconfig
```kconfig
if TARGET_HI309x

config SYS_BOARD
	default "hi309x"

config SYS_VENDOR
	default "hisilicon"

config SYS_TEXT_BASE
	default 0x87200000

config SYS_SRAM_SIZE
	hex
	default 0x20000

config SYS_SRAM_BASE
	hex
	default 0x08100000

config SYS_LOAD_ADDR
	hex "Address in memory to use by default"
	default 0x8B200000
	help
	  Address in memory to use as the default safe load address.

config SYS_SOC
	default "hi309x"

config SYS_CONFIG_NAME
	default "hi309x"

config HI309x_FPGA
	bool "Support Hisilicon 309x fpga board"
	help
	  Hi309x FPGA board support(normally defined in configs/hi309x_defconfig)

config HI309x_CA53
	bool "Hi309x using Cortex-A53 core"
	help
		If Hi309x is implemented using Cortex-A53, please select this config
		Generally defined in configs/hi309x_defconfig

config COUNTER_FREQUENCY
	int "Timer clock frequency"
	default 25000000

config ATF_FW_OFFSET
	int "ATF OFFSET"
	default 552960

config CMD_NFS
	bool "nfs"
	default n
	help
	  Boot image via network using NFS protocol.

config EFI_SETUP_EARLY
	bool
	default n

config BSP_DISABLE_CONSOLE
	bool "disable some debug info"
	default y

config IF_PRIVATE_DEVICE
	bool "use private emmc device"
	default y

config ENV_IS_PRIVATE_DEVICE
	bool "env use private emmc device"
	default y

config DRIVER_PRIVATE_MMC
	bool "use private emmc driver"
	default y

config BOOT_FROM_ATF
	bool
	default y

config SYS_DEPLOY_TYPE
	hex "deploy Type"
	default 0x1
	help
	  0x1 : Baremetal Only
	  0x2 : Euler Only
	  0x4 : Euler + Baremetal
	  0x8 : Euler + Uniporton/Libck

config BOOT_FROM_USER
	  bool "boot from user part, offset see env(part2_user_offset)"
	  default n

config HI3093_SPI_BOOT
	bool "enable 3093 boot from sfc"
	default n
	help
	  enable 3093 boot from sfc

config HI3093_MMC_BOOT
	bool "enable 3093 boot from emmc"
	default y if !HI3093_SPI_BOOT
	default n
	help
	  enable 3093 boot from emmc

endif
```

## open_source/u-boot/u-boot/configs/hi3093_euler_defconfig
```kconfig
CONFIG_ARM=y
CONFIG_TARGET_HI309x=y
CONFIG_ARCH_HI309x=y
CONFIG_HISI_GICV3=n
CONFIG_HI309x_CA53=n
CONFIG_HI309x_FPGA=n
CONFIG_BAUDRATE=115200
CONFIG_SYS_MALLOC_F_LEN=0x2000
CONFIG_IDENT_STRING="hi309x"
CONFIG_BOOTCOMMAND="run hi309x_linux"
CONFIG_BOOTDELAY=3
CONFIG_HI3093_MMC_BOOT=y
CONFIG_EXT4_WRITE=y
CONFIG_USE_BOOTARGS=y
CONFIG_DISTRO_DEFAULTS=y
CONFIG_DISPLAY_BOARDINFO=y
CONFIG_BOARD_EARLY_INIT_F=y
CONFIG_ARMV8_SWITCH_TO_EL1=n
# CONFIG_CMD_IMLS is not set
CONFIG_DM_GPIO=y
CONFIG_DM_I2C=y
CONFIG_DM_SPI=y
CONFIG_DM_ETH=y
#Use legacy SPI Flash driver
CONFIG_SPI=y
CONFIG_SPI_FLASH=y
CONFIG_HI3093_SPI=y
CONFIG_SPI_FLASH_MACRONIX=y
CONFIG_SPI_FLASH_BAR=y
CONFIG_SPI_FLASH_USE_4K_SECTORS=n
CONFIG_HI309x_SERIAL=y
CONFIG_HI309x_GPIO=y
CONFIG_SYS_I2C_HI309x=y
CONFIG_HI309x_SPI=y
CONFIG_CONS_INDEX=1
CONFIG_CMD_UNZIP=y
CONFIG_CMD_CACHE=y
CONFIG_CMD_LOADB=y
CONFIG_CMD_SF=y
CONFIG_CMD_ELF=n
CONFIG_CMD_BOOTI=n
CONFIG_CMD_BOOTD=n
CONFIG_CMD_BOOTEFI=n
CONFIG_AUTOBOOT=y
CONFIG_OF_LIBFDT=y
#No hard disk partiton support since no IDE or SCSI
CONFIG_CMD_GPT=n
CONFIG_CMD_PART=n
CONFIG_PARTITIONS=y
CONFIG_PARTIONS_UUIDS=n
CONFIG_CMD_FPGA=n
CONFIG_BLK=y
CONFIG_BLOCK_CACHE=y
CONFIG_DM_MMC=y
CONFIG_OF_BOARD_SETUP=y
CONFIG_CMD_CRAMFS=n
CONFIG_FS_CRAMFS=n
CONFIG_REQUIRE_SERIAL_CONSOLE=y
CONFIG_MISC_INIT_R=y
CONFIG_ENV_SIZE=0x10000
CONFIG_SYS_MALLOC_LEN=0x110000
CONFIG_BOOTP_BOOTFILESIZE=y
CONFIG_MTD_PARTITIONS=y
CONFIG_ARMV8_MULTIENTRY=y
CONFIG_REMAKE_ELF=y
CONFIG_EFI_SETUP_EARLY=n
CONFIG_COUNTER_FREQUENCY=25000000
CONFIG_BSP_DISABLE_CONSOLE=y
CONFIG_IF_PRIVATE_DEVICE=y
CONFIG_ENV_IS_PRIVATE_DEVICE=y
CONFIG_DRIVER_PRIVATE_MMC=y
CONFIG_BOOT_FROM_ATF=y
CONFIG_SYS_DEPLOY_TYPE=2
CONFIG_BOOT_FROM_USER=n
CONFIG_ATF_FW_OFFSET=450560
```

## tools/dts/bindings/hi3093/gic.yaml
```yaml
description: ARM Generic Interrupt Controller

compatible: "arm,gic"

include: base.yaml

properties:
  reg:
    required: true
  redistributor-stride:
    type: compound
    required: false

interrupt-cells:
  - type
  - irq
  - flags
```

## tools/dts/bindings/hi3093/gmac.yaml
```yaml
description: Synopsys Designware GMAC Controller node

compatible: "hisilicon, hi1711_gmac_net"

include: base.yaml

bus: gmac

properties:
  interrupts:
    required: false
  reg:
    required: false
  phy_addr:
    type: array
    required: false
  domain:
    type: array
    required: true
```

## tools/dts/bindings/hi3093/gpio.yaml
```yaml
description: Synopsys Designware GPIO Controller node

compatible: "hisilicon,hi1711-gpio"

include: base.yaml

bus: gpio

properties:
  interrupts:
    required: false
  reg:
    required: false
  rising-edge:
    description: Enables support for rising edge interrupt detection
    type: boolean

  falling-edge:
    description: Enables support for falling edge interrupt detection
    type: boolean

  high-level:
    description: Enables support for high level interrupt detection
    type: boolean

  low-level:
    description: Enables support for low level interrupt detection
    type: boolean
    
  domain:
    type: array
    required: true
  

gpio-cells:
  - pin
  - flags
```

## tools/dts/bindings/hi3093/i2c.yaml
```yaml
description: Synopsys Designware I2C Controller node

include: base.yaml

compatible: "hisilicon,hi1711-i2c"

bus: i2c

properties:
  domain:
    type: array
    required: true
    description: Provided names of mailbox / IPM channel specifiers
```

## tools/dts/bindings/hi3093/localbus.yaml
```yaml
description: Synopsys Designware LOCALBUS Controller node

compatible: "hisilicon, hi1711-localbus"

include: base.yaml

bus: localbus

properties:
  interrupts:
    required: false
  reg:
    required: false
  domain:
    type: array
    required: true
  
```

## tools/dts/bindings/hi3093/spi.yaml
```yaml
description: Synopsys Designware SPI node

compatible: "hisilicon,hisi-spi"

include: base.yaml

bus: spi

properties:
  reg:
    required: false
  ctlid:
    type: array
    required: false
  clock-sel:
    type: array
    required: false
  interrupts:
    required: false
  domain:
    type: array
    required: true
  
```

## tools/dts/bindings/hi3093/timer.yaml
```yaml
description: Synopsys Designware TIMER node

compatible : "hisilicon,hisi-timer"

include: base.yaml

bus: timer

properties:
  ids:
    type: array
    required: false
  reg:
    required: false
  clock-sel:
    type: array
    required: false
  interrupts:
    required: false
  domain:
    type: array
    required: true
    description: Provided names of mailbox / IPM channel specifiers
```

## tools/dts/bindings/hi3093/uart.yaml
```yaml
description: Synopsys Designware UART Controller node

compatible : "hisilicon,hisi-uart"

include: base.yaml

bus: uart

properties:
  interrupts:
    required: false
  reg:
    required: false
  port-no:
    type: array
    required: false
  domain:
    type: array
    required: true
```

## tools/dts/bindings/hi3093/watchdog.yaml
```yaml
description: Synopsys Designware WATCHDOG Controller node

compatible : "hisilicon, hi1711-watchdog"

include: base.yaml

bus: watchdog

properties:
  domain:
    type: array
    required: true
```
